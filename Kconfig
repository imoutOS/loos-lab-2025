## Kconfig
```kconfig
menu "Debugging and Assertion Options"

config ENABLE_DEBUG
    bool "Enable Debugging Output (Log/Assert)"
    default y
    help
      Enables debug logging (Log macro) and runtime assertion checks.
      Disabling this will remove all debug output and assertions from the build.

config FORCE_PANIC_MESSAGES
    bool "Always Show Panic Messages"
    depends on ENABLE_DEBUG
    default n
    help
      Even when debug is disabled, panic() will still print messages.
      This forces panic messages to always be visible regardless of debug mode.

config LOG_LEVEL
    int "Log Verbosity Level (0-4)"
    range 0 4
    default 2
    depends on ENABLE_DEBUG
    help
      0: Emergency
      1: Critical
      2: Info
      3: Debug
      4: Trace

config ASSERT_HALT_BEHAVIOR
    bool "Halt System on Assertion Failure"
    default y
    help
      Call halt(1) when an assertion fails. Disable this if you want to
      continue execution after failed assertions (not recommended).

endmenu

source "arch/Kconfig"
```

## arch/loongarch/Kconfig
```kconfig
config ARCH_LOONGARCH
    bool "loongarch config"
    default y
    help
      this is a arch_default config_target
      this is useful when we want to know our arch in code
      help to generate autoconf.h so we can use in code
      remember do not change it forever

menu "a trick to select ARCH_LOONGARCH"
visible if False
    config ARCH_TEST18927389123123
        bool "a trick config"
        default y
        select ARCH_LOONGARCH
        help
          a trick config and menu to
          select ARCH_LOONGARCH config
          to let user can not change it
endmenu 

source "arch/$(ARCH)/board/Kconfig"
```

## arch/loongarch/board/Kconfig
```kconfig
choice
    prompt "select loong board"
    default QEMU_VIRT
    help
      select loongarch board
      this will affect dts path

    config QEMU_VIRT
        bool "qemu board"

    config 2K100
        bool "2k100 board"

endchoice

menu "dts config"
# do not let user know it
# but actually we will use is in kbuild system
visible if False

config DTS_PATH
    string "dts path"
    default "$(src_tree)/arch/$(ARCH)/board/qemu_loongarch_virt/device.dts" if QEMU_VIRT
    default "$(src_tree)/arch/$(ARCH)/boatd/2k100/device.dts" if 2K100
    help
      device tree path
      it is only effected by BOARD_SELECT

endmenu
```

## arch/riscv/Kconfig
```kconfig
config ARCH_RISCV
    bool "riscv arch config"
    default y
    help
      this is a arch_default config_target
      this is useful when we want to know our arch in code
      help to generate autoconf.h so we can use in code
      remember do not change it forever

menu "a trick to select ARCH_RISCV"
visible if False
    config ARCH_TEST128273198
        bool "trick config"
        default y
        select ARCH_RISCV
        help
          the menu and config is just a trick
          and will not port to user, but it can
          select ARCH_RISCV config , let user can
          not change it 
endmenu

source "arch/$(ARCH)/board/Kconfig"
```

## arch/riscv/board/Kconfig
```kconfig
choice 
    prompt "select riscv board"
    help
     this choice select a target riscv board
     different board has different dts and phy memorylayout
    default BOARD_RV64QEMU_VIRT

config BOARD_RV64QEMU_VIRT
    bool "riscv64 qemu virt machine"
    help
      riscv64 qemu board select
    
config BOARD_VISIONFIVE2
    bool "visionfive2 board"
    help
      riscv64 visionfive2 board select

endchoice

menu "dts config"
#make all menu not visible to user
#but we can use in the kbuild system or in the code
visible if False

config DTS_PATH
    string "dts path"
    default "$(src_tree)/arch/$(ARCH)/board/qemu_riscv64_virt/device.dts" if BOARD_RV64QEMU_VIRT
    default "$(src_tree)/arch/$(ARCH)/board/visionfive2/device.dts" if BOARD_VISIONFIVE2
    help 
      device tree path
      it is only effected by BOARD_SELECT
endmenu 
```
